## development/Kconfig
```kconfig
# Kconfig for PCAL95555 GPIO expander
menuconfig PCAL95555
    bool "PCAL95555 GPIO expander"
    default y
    help
      Enable support for the NXP PCAL95555 16-bit I/O expander.
      When enabled, the driver library can be built and configured
      with the options below.

if PCAL95555

menu "General settings"

config PCAL95555_DEFAULT_ADDRESS
    hex "Default I2C address"
    default 0x20
    help
      I2C slave address of the device. The PCAL95555 allows
      addresses in the range 0x20-0x27 depending on the A0/A1 pins.

config PCAL95555_INIT_FROM_KCONFIG
    bool "Enable InitFromConfig runtime initialization"
    default y
    help
      When enabled, calling InitFromConfig() will apply the
      configuration values selected here at runtime. Disable to
      compile the driver with InitFromConfig() as a no-op.

endmenu

menu "Port 0"

config PCAL95555_PORT0_OD
    bool "Open-drain mode"
    default n
    help
      Drive all pins on port 0 in open-drain mode when enabled.


menu "Pin 0"
config PCAL95555_P0_0_DIR
    bool "Input direction"
    default y
config PCAL95555_P0_0_PULL
    bool "Enable pull resistor"
    default n
config PCAL95555_P0_0_PULL_UP
    bool "Use pull-up"
    default y
config PCAL95555_P0_0_OUTPUT
    bool "Initial output high"
    default n
endmenu

menu "Pin 1"
config PCAL95555_P0_1_DIR
    bool "Input direction"
    default y
config PCAL95555_P0_1_PULL
    bool "Enable pull resistor"
    default n
config PCAL95555_P0_1_PULL_UP
    bool "Use pull-up"
    default y
config PCAL95555_P0_1_OUTPUT
    bool "Initial output high"
    default n
endmenu

menu "Pin 2"
config PCAL95555_P0_2_DIR
    bool "Input direction"
    default y
config PCAL95555_P0_2_PULL
    bool "Enable pull resistor"
    default n
config PCAL95555_P0_2_PULL_UP
    bool "Use pull-up"
    default y
config PCAL95555_P0_2_OUTPUT
    bool "Initial output high"
    default n
endmenu

menu "Pin 3"
config PCAL95555_P0_3_DIR
    bool "Input direction"
    default y
config PCAL95555_P0_3_PULL
    bool "Enable pull resistor"
    default n
config PCAL95555_P0_3_PULL_UP
    bool "Use pull-up"
    default y
config PCAL95555_P0_3_OUTPUT
    bool "Initial output high"
    default n
endmenu

menu "Pin 4"
config PCAL95555_P0_4_DIR
    bool "Input direction"
    default y
config PCAL95555_P0_4_PULL
    bool "Enable pull resistor"
    default n
config PCAL95555_P0_4_PULL_UP
    bool "Use pull-up"
    default y
config PCAL95555_P0_4_OUTPUT
    bool "Initial output high"
    default n
endmenu

menu "Pin 5"
config PCAL95555_P0_5_DIR
    bool "Input direction"
    default y
config PCAL95555_P0_5_PULL
    bool "Enable pull resistor"
    default n
config PCAL95555_P0_5_PULL_UP
    bool "Use pull-up"
    default y
config PCAL95555_P0_5_OUTPUT
    bool "Initial output high"
    default n
endmenu

menu "Pin 6"
config PCAL95555_P0_6_DIR
    bool "Input direction"
    default y
config PCAL95555_P0_6_PULL
    bool "Enable pull resistor"
    default n
config PCAL95555_P0_6_PULL_UP
    bool "Use pull-up"
    default y
config PCAL95555_P0_6_OUTPUT
    bool "Initial output high"
    default n
endmenu

menu "Pin 7"
config PCAL95555_P0_7_DIR
    bool "Input direction"
    default y
config PCAL95555_P0_7_PULL
    bool "Enable pull resistor"
    default n
config PCAL95555_P0_7_PULL_UP
    bool "Use pull-up"
    default y
config PCAL95555_P0_7_OUTPUT
    bool "Initial output high"
    default n
endmenu
endmenu

menu "Port 1"

config PCAL95555_PORT1_OD
    bool "Open-drain mode"
    default n
    help
      Drive all pins on port 1 in open-drain mode when enabled.

menu "Pin 0"
config PCAL95555_P1_0_DIR
    bool "Input direction"
    default y
config PCAL95555_P1_0_PULL
    bool "Enable pull resistor"
    default n
config PCAL95555_P1_0_PULL_UP
    bool "Use pull-up"
    default y
config PCAL95555_P1_0_OUTPUT
    bool "Initial output high"
    default n
endmenu

menu "Pin 1"
config PCAL95555_P1_1_DIR
    bool "Input direction"
    default y
config PCAL95555_P1_1_PULL
    bool "Enable pull resistor"
    default n
config PCAL95555_P1_1_PULL_UP
    bool "Use pull-up"
    default y
config PCAL95555_P1_1_OUTPUT
    bool "Initial output high"
    default n
endmenu

menu "Pin 2"
config PCAL95555_P1_2_DIR
    bool "Input direction"
    default y
config PCAL95555_P1_2_PULL
    bool "Enable pull resistor"
    default n
config PCAL95555_P1_2_PULL_UP
    bool "Use pull-up"
    default y
config PCAL95555_P1_2_OUTPUT
    bool "Initial output high"
    default n
endmenu

menu "Pin 3"
config PCAL95555_P1_3_DIR
    bool "Input direction"
    default y
config PCAL95555_P1_3_PULL
    bool "Enable pull resistor"
    default n
config PCAL95555_P1_3_PULL_UP
    bool "Use pull-up"
    default y
config PCAL95555_P1_3_OUTPUT
    bool "Initial output high"
    default n
endmenu

menu "Pin 4"
config PCAL95555_P1_4_DIR
    bool "Input direction"
    default y
config PCAL95555_P1_4_PULL
    bool "Enable pull resistor"
    default n
config PCAL95555_P1_4_PULL_UP
    bool "Use pull-up"
    default y
config PCAL95555_P1_4_OUTPUT
    bool "Initial output high"
    default n
endmenu

menu "Pin 5"
config PCAL95555_P1_5_DIR
    bool "Input direction"
    default y
config PCAL95555_P1_5_PULL
    bool "Enable pull resistor"
    default n
config PCAL95555_P1_5_PULL_UP
    bool "Use pull-up"
    default y
config PCAL95555_P1_5_OUTPUT
    bool "Initial output high"
    default n
endmenu

menu "Pin 6"
config PCAL95555_P1_6_DIR
    bool "Input direction"
    default y
config PCAL95555_P1_6_PULL
    bool "Enable pull resistor"
    default n
config PCAL95555_P1_6_PULL_UP
    bool "Use pull-up"
    default y
config PCAL95555_P1_6_OUTPUT
    bool "Initial output high"
    default n
endmenu

menu "Pin 7"
config PCAL95555_P1_7_DIR
    bool "Input direction"
    default y
config PCAL95555_P1_7_PULL
    bool "Enable pull resistor"
    default n
config PCAL95555_P1_7_PULL_UP
    bool "Use pull-up"
    default y
config PCAL95555_P1_7_OUTPUT
    bool "Initial output high"
    default n
endmenu
endmenu

endif # PCAL95555
```
